## Kconfig
```
#
# Copyright (c) 2022 Nordic Semiconductor ASA
#
# SPDX-License-Identifier: LicenseRef-Nordic-5-Clause
#

menu "Zephyr Kernel"
source "Kconfig.zephyr"
endmenu

config INCLUDE_NET_CORE_IMAGE
	bool "Include net image as sub image"
	depends on SOC_NRF5340_CPUAPP
	default y if (BOARD_NRF5340DK_NRF5340_CPUAPP || BOARD_NRF5340DK_NRF5340_CPUAPPNS)
	select BOARD_ENABLE_CPUNET
	select NCS_INCLUDE_BLINKY_CHILD_IMAGE
```

## sample.yaml
```
sample:
  description: Zigbee Blinky sample for upgrading nrf55L15
  name: Zigbee Blinky mcuboot
tests:
  sample.zigbee.blinky_mcuboot:
    sysbuild: true
    build_only: true
    integration_platforms:
      - nrf54l15dk/nrf54l15/cpuapp
    platform_allow:
      - nrf54l15dk/nrf54l15/cpuapp
    tags: ci_build
```

## sysbuild.conf
```
#
# Copyright (c) 2024 Nordic Semiconductor ASA
#
# SPDX-License-Identifier: LicenseRef-Nordic-5-Clause
#

SB_CONFIG_BOOTLOADER_MCUBOOT=y
SB_CONFIG_DFU_MULTI_IMAGE_PACKAGE_BUILD=y
SB_CONFIG_DFU_ZIP=y
```

## prj.conf
```kconfig
CONFIG_PRINTK=y
CONFIG_GPIO=y

CONFIG_BOOTLOADER_MCUBOOT=y
CONFIG_MCUBOOT_IMGTOOL_SIGN_VERSION="99.99.99"
```

## src/main.c
```c
/*
 * Copyright (c) 2016 Intel Corporation
 *
 * SPDX-License-Identifier: Apache-2.0
 */

#include <zephyr/kernel.h>
#include <zephyr/drivers/gpio.h>

/* 1000 msec = 1 sec */
#define SLEEP_TIME_MS   1000

/* The devicetree node identifier for the "led0" alias. */
#define LED2_NODE DT_ALIAS(led2)

#if IS_ENABLED(CONFIG_NCS_INCLUDE_BLINKY_CHILD_IMAGE)
#pragma message "We have NCS_INCLUDE_BLINKY_CHILD_IMAGE"
#endif

#if IS_ENABLED(CONFIG_NCS_INCLUDE_RPMSG_CHILD_IMAGE)
#pragma message "We have NCS_INCLUDE_RPMSG_CHILD_IMAGE"
#endif

#if IS_ENABLED(CONFIG_NCS_SAMPLE_BLINKY_CHILD_IMAGE)
#pragma message "We have NCS_SAMPLE_BLINKY_CHILD_IMAGE"
#endif

/*
 * A build error on this line means your board is unsupported.
 * See the sample documentation for information on how to fix this.
 */
static const struct gpio_dt_spec led = GPIO_DT_SPEC_GET(LED2_NODE, gpios);

int main(void)
{
	int ret;

	printk("Hello world from %s\n", CONFIG_BOARD);

	if (!device_is_ready(led.port)) {
		return 0;
	}

	ret = gpio_pin_configure_dt(&led, GPIO_OUTPUT_ACTIVE);
	if (ret < 0) {
		return 0;
	}

	while (1) {
		ret = gpio_pin_toggle_dt(&led);
		if (ret < 0) {
			return 0;
		}
		k_msleep(SLEEP_TIME_MS);
	}
    
    return 0;
}
```
