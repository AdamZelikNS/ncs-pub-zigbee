## samples/light_bulb/sample.yaml
```yaml
sample:
  description: Zigbee Light control - light bulb sample
  name: Zigbee Light control
tests:
  sample.zigbee.light_bulb:
    sysbuild: true
    build_only: true
    integration_platforms:
      - nrf52840dk/nrf52840
    platform_allow:
      - nrf52840dk/nrf52840
    tags:
      - ci_build
      - smoke
      - sysbuild
      - ci_samples_zigbee
```

## samples/light_switch/Kconfig
```kconfig
#
# Copyright (c) 2024 Nordic Semiconductor ASA
#
# SPDX-License-Identifier: LicenseRef-Nordic-5-Clause
#

menu "Zephyr Kernel"
source "Kconfig.zephyr"
endmenu

module = NUS_CMD
module-str = NUS command
source "${ZEPHYR_BASE}/subsys/logging/Kconfig.template.log_config"


config LIGHT_SWITCH_CONFIGURE_TX_POWER
	bool "Configure TX power"
	default y
	help
		Enable this option to configure TX power for the sample.

config LIGHT_SWITCH_TX_POWER
	int "TX power"
	depends on LIGHT_SWITCH_CONFIGURE_TX_POWER
	default 0
	help
		TX power level in dBm.

config LIGHT_SWITCH_FORCE_LED_BLINK
	int "LED identifier forced to blink continuously"
	default -1
	help
		Forces one of the LEDs to blink at a fixed interval. A value of -1 disables such blinking.
```

## samples/light_switch/sample.yaml
```yaml
sample:
  description: Zigbee dimmable light switch based on ZBOSS stack
  name: Zigbee Light switch
tests:
  sample.zigbee.light_switch:
    sysbuild: true
    build_only: true
    integration_platforms:
      - nrf54l15dk/nrf54l15/cpuapp
    platform_allow:
      - nrf54l15dk/nrf54l15/cpuapp
    tags:
      - ci_build
      - smoke
      - sysbuild
      - ci_samples_zigbee
  sample.zigbee.light_switch.fota:
    sysbuild: true
    build_only: true
    extra_args:
      - FILE_SUFFIX=fota
    integration_platforms:
      - nrf54l15dk/nrf54l15/cpuapp
    platform_allow:
      - nrf54l15dk/nrf54l15/cpuapp
    tags:
      - ci_build
      - smoke
      - sysbuild
      - ci_samples_zigbee
```

## samples/ncp/sample.yaml
```yaml
sample:
  description: Zigbee network co-processor
  name: Zigbee NCP
tests:
  sample.zigbee.ncp:
    sysbuild: true
    build_only: true
    integration_platforms:
      - nrf54l15dk/nrf54l15/cpuapp
      - nrf52840dk/nrf52840
    platform_allow:
      - nrf54l15dk/nrf54l15/cpuapp
      - nrf52840dk/nrf52840
    tags:
      - ci_build
      - smoke
      - sysbuild
      - ci_samples_zigbee
  sample.zigbee.ncp.usb:
    sysbuild: true
    build_only: true
    integration_platforms:
      - nrf52840dk/nrf52840
    platform_allow:
      - nrf52840dk/nrf52840
    tags:
      - ci_build
      - ncp
      - sysbuild
      - ci_samples_zigbee
    extra_args:
      - FILE_SUFFIX=usb
  sample.zigbee.ncp.dongle:
    sysbuild: true
    build_only: true
    integration_platforms:
      - nrf52840dongle/nrf52840
    platform_allow:
      - nrf52840dongle/nrf52840
    tags:
      - ci_build
      - ncp
      - sysbuild
      - ci_samples_zigbee
    extra_args:
      - FILE_SUFFIX=dongle
  sample.zigbee.ncp.p1i:
    sysbuild: true
    build_only: true
    integration_platforms:
      - nrf52840dk/nrf52840
    platform_allow:
      - nrf52840dk/nrf52840
    tags:
      - ci_build
      - ncp
      - sysbuild
      - ci_samples_zigbee
    extra_args:
      - FILE_SUFFIX=p1i
```

## samples/shell/sample.yaml
```yaml
sample:
  description: Zigbee application that includes all Zigbee shell commands
  name: Zigbee application with Zigbee shell
tests:
  sample.zigbee.shell:
    build_only: true
    sysbuild: true
    integration_platforms:
      - nrf52840dk/nrf52840
    platform_allow:
      - nrf52840dk/nrf52840
    tags:
      - ci_build
      - shell
      - sysbuild
      - ci_samples_zigbee
```

## samples/template/sample.yaml
```yaml
sample:
  description: Zigbee application template
  name: Zigbee application template
tests:
  sample.zigbee.template:
    sysbuild: true
    build_only: true
    integration_platforms:
      - nrf52840dk/nrf52840
    platform_allow:
      - nrf52840dk/nrf52840
    tags:
      - ci_build
      - smoke
      - sysbuild
      - ci_samples_zigbee
```

## west.yml
```yaml
# Copyright (c) 2024 Nordic Semiconductor ASA
# SPDX-License-Identifier: Apache-2.0

manifest:
  remotes:
    - name: ncs
      url-base: https://github.com/nrfconnect
    - name: gh_adze
      url-base: https://github.com/AdamZelikNS

  projects:
    - name: nrf
      remote: gh_adze
      repo-path: sdk-nrf
      revision: tst/radio_rx_end_rx_rdy_latency
      import: true
```
